## Kconfig
```kconfig
menu "ArdPortal"
    config ARDPORTAL_MATTER
        bool "Enable Matter integration"
        default n

    choice ARDPORTAL_MATTER_NETWORK
        prompt "Matter transport and portal network"
        depends on ARDPORTAL_MATTER
        default ARDPORTAL_MATTER_WIFI if SOC_WIFI_SUPPORTED
        default ARDPORTAL_MATTER_THREAD_ONLY

        config ARDPORTAL_MATTER_WIFI
            bool "Matter Wi-Fi + BLE"
            depends on SOC_WIFI_SUPPORTED

        config ARDPORTAL_MATTER_THREAD_ONLY
            bool "Matter Thread + BLE, no Wi-Fi portal"
            depends on SOC_IEEE802154_SUPPORTED

        config ARDPORTAL_MATTER_THREAD_WIFI
            bool "Matter Thread + BLE, Wi-Fi portal"
            depends on SOC_IEEE802154_SUPPORTED && SOC_WIFI_SUPPORTED
    endchoice

    choice ARDPORTAL_MATTER_CREDENTIALS
        prompt "Matter credential profile"
        depends on ARDPORTAL_MATTER
        default ARDPORTAL_MATTER_DEVELOPMENT

        config ARDPORTAL_MATTER_DEVELOPMENT
            bool "Development: SDK test credentials"

        config ARDPORTAL_MATTER_PRODUCTION
            bool "Production: provisioned factory credentials"
    endchoice

    config ARDPORTAL_MATTER_MAX_ENDPOINTS
        int "Maximum application Matter endpoints"
        depends on ARDPORTAL_MATTER
        range 1 64
        default 16
endmenu
```

## idf/MatterPortal/sdkconfig.defaults
```kconfig
CONFIG_AUTOSTART_ARDUINO=y
CONFIG_FREERTOS_HZ=1000
CONFIG_COMPILER_OPTIMIZATION_SIZE=y
CONFIG_COMPILER_CXX_EXCEPTIONS=n
CONFIG_ARDUINO_SELECTIVE_COMPILATION=y
CONFIG_ARDPORTAL_MATTER=y
CONFIG_ARDPORTAL_MATTER_MAX_ENDPOINTS=16
CONFIG_ESP_MATTER_MAX_DYNAMIC_ENDPOINT_COUNT=17
CONFIG_ESP_MATTER_ENABLE_DATA_MODEL=y
CONFIG_BT_ENABLED=y
CONFIG_BT_NIMBLE_ENABLED=y
CONFIG_ENABLE_CHIPOBLE=y
CONFIG_USE_BLE_ONLY_FOR_COMMISSIONING=n
CONFIG_MBEDTLS_HKDF_C=y
CONFIG_LWIP_IPV6=y
CONFIG_LWIP_IPV6_NUM_ADDRESSES=8
CONFIG_USE_MINIMAL_MDNS=n
CONFIG_PARTITION_TABLE_CUSTOM=y
CONFIG_PARTITION_TABLE_CUSTOM_FILENAME="partitions.csv"
CONFIG_ESPTOOLPY_FLASHSIZE_4MB=y
CONFIG_LOG_DEFAULT_LEVEL_WARN=y

# Keep DMA-capable SRAM available for BLE, WPA handshakes and HTTP buffers.
# Matter/portal traffic does not need the Wi-Fi throughput IRAM optimizations.
CONFIG_ESP_WIFI_IRAM_OPT=n
CONFIG_ESP_WIFI_EXTRA_IRAM_OPT=n
CONFIG_ESP_WIFI_RX_IRAM_OPT=n
CONFIG_ESP_WIFI_SLP_IRAM_OPT=n

# Arduino defaults each individual library to y; use an explicit allowlist.
CONFIG_ARDUINO_SELECTIVE_SPI=n
CONFIG_ARDUINO_SELECTIVE_Wire=n
CONFIG_ARDUINO_SELECTIVE_ESP_SR=n
CONFIG_ARDUINO_SELECTIVE_ESP_Video=n
CONFIG_ARDUINO_SELECTIVE_EEPROM=n
CONFIG_ARDUINO_SELECTIVE_Preferences=y
CONFIG_ARDUINO_SELECTIVE_Ticker=n
CONFIG_ARDUINO_SELECTIVE_Update=n
CONFIG_ARDUINO_SELECTIVE_Zigbee=n
CONFIG_ARDUINO_SELECTIVE_FS=n
CONFIG_ARDUINO_SELECTIVE_SD=n
CONFIG_ARDUINO_SELECTIVE_SD_MMC=n
CONFIG_ARDUINO_SELECTIVE_SPIFFS=n
CONFIG_ARDUINO_SELECTIVE_FFat=n
CONFIG_ARDUINO_SELECTIVE_LittleFS=n
CONFIG_ARDUINO_SELECTIVE_Network=y
CONFIG_ARDUINO_SELECTIVE_Ethernet=n
CONFIG_ARDUINO_SELECTIVE_PPP=n
CONFIG_ARDUINO_SELECTIVE_Hash=n
CONFIG_ARDUINO_SELECTIVE_ArduinoOTA=n
CONFIG_ARDUINO_SELECTIVE_AsyncUDP=n
CONFIG_ARDUINO_SELECTIVE_DNSServer=n
CONFIG_ARDUINO_SELECTIVE_ESPmDNS=y
CONFIG_ARDUINO_SELECTIVE_HTTPClient=n
CONFIG_ARDUINO_SELECTIVE_Matter=y
CONFIG_ARDUINO_SELECTIVE_NetBIOS=n
CONFIG_ARDUINO_SELECTIVE_WebServer=n
CONFIG_ARDUINO_SELECTIVE_WiFi=n
CONFIG_ARDUINO_SELECTIVE_NetworkClientSecure=n
CONFIG_ARDUINO_SELECTIVE_WiFiProv=n
CONFIG_ARDUINO_SELECTIVE_BLE=n
CONFIG_ARDUINO_SELECTIVE_BluetoothSerial=n
CONFIG_ARDUINO_SELECTIVE_SimpleBLE=n
CONFIG_ARDUINO_SELECTIVE_RainMaker=n
CONFIG_ARDUINO_SELECTIVE_OpenThread=n
CONFIG_ARDUINO_SELECTIVE_Insights=n

# Matter commissions as a BLE peripheral with one concurrent connection.
# Keep buffer pools above the ESP-Matter low-memory recommendations.
CONFIG_BT_NIMBLE_MAX_CONNECTIONS=1
CONFIG_BT_NIMBLE_ROLE_CENTRAL=n
CONFIG_BT_NIMBLE_ROLE_OBSERVER=n
CONFIG_BT_NIMBLE_MSYS_1_BLOCK_COUNT=12
CONFIG_BT_NIMBLE_MSYS_2_BLOCK_COUNT=8
CONFIG_BT_NIMBLE_TRANSPORT_ACL_FROM_LL_COUNT=8
CONFIG_BT_NIMBLE_TRANSPORT_EVT_COUNT=12
CONFIG_BT_NIMBLE_TRANSPORT_EVT_DISCARD_COUNT=4
```
